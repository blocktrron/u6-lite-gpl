## gpl-uboot-u6lite-1.1.44/uboot-uap-mtk-1.1.44/configs/ubnt_uap6_ubntapp_defconfig
```kconfig
CONFIG_MIPS=y
CONFIG_SPL_LDSCRIPT="arch/$(ARCH)/mach-mt7621/u-boot-spl-rom.lds"
CONFIG_SYS_TEXT_BASE=0x84000000
CONFIG_SPL_LIBCOMMON_SUPPORT=y
CONFIG_SPL_LIBGENERIC_SUPPORT=y
CONFIG_SPL_SERIAL_SUPPORT=y
CONFIG_MACH_MT7621=y
CONFIG_BOARD_MT7621_UBNT=y
CONFIG_BOARD_UBNT_UAP=y
# CONFIG_MT7621_DRAM_FREQ_400 is not set
# CONFIG_MT7621_DRAM_FREQ_800 is not set
# CONFIG_MT7621_DRAM_FREQ_1066 is not set
CONFIG_MT7621_DRAM_FREQ_1200=y
CONFIG_MT7621_DRAM_FREQ=1200
CONFIG_MT7621_DRAM_INIT_USER_PARAM_FIRST=y
CONFIG_MT7621_DRAM_INIT_USER_PARAM_PREDEFINED=y
# CONFIG_MT7621_DRAM_INIT_USER_PARAM_BOARD_PROVIDED is not set
# CONFIG_MT7621_DRAM_DDR2_512M is not set
CONFIG_MT7621_DRAM_DDR2_1024M=y
# CONFIG_MT7621_DRAM_DDR2_512M_W9751G6KB_A02_1066MHZ is not set
# CONFIG_MT7621_DRAM_DDR2_1024M_W971GG6KB25_800MHZ is not set
# CONFIG_MT7621_DRAM_DDR2_1024M_W971GG6KB18_1066MHZ is not set
# CONFIG_MT7621_DRAM_DDR3_1024M is not set
# CONFIG_MT7621_DRAM_DDR3_1024M_KGD is not set
CONFIG_MT7621_DRAM_DDR3_2048M=y
# CONFIG_MT7621_DRAM_DDR3_4096M is not set
#CONFIG_MT7621_DRAMC_DEBUG is not set
CONFIG_MT7621_DRAM_RESET_DELAY=300
CONFIG_UBNT_MT7621_DRAM_INIT_RECOVERY_SW_RESET=y
# CONFIG_UBNT_MT7621_DRAM_INIT_RECOVERY_HW_RESET is not set
CONFIG_ROM_EXCEPTION_VECTORS=y
CONFIG_MIPS_BOOT_FDT=y
CONFIG_DEFAULT_DEVICE_TREE="ubnt_uap6"
CONFIG_DEBUG_UART=y
CONFIG_SPL_SYS_MALLOC_F_LEN=0x10000
# CONFIG_EXPERT is not set
CONFIG_FIT=y
CONFIG_FIT_SIGNATURE=y
CONFIG_FIT_VERBOSE=y
# CONFIG_ARCH_FIXUP_FDT_MEMORY is not set
CONFIG_USE_BOOTCOMMAND=y
CONFIG_BOOTCOMMAND="bootubnt"
CONFIG_DISPLAY_CPUINFO=y
# CONFIG_DISPLAY_BOARDINFO is not set
CONFIG_SPL=y
# CONFIG_SPL_RAW_IMAGE_SUPPORT is not set
CONFIG_SPL_SYS_MALLOC_SIMPLE=y
CONFIG_SPL_MTK_SUPPORT=y
CONFIG_SYS_PROMPT="MT7621 #"
CONFIG_CMD_BOOTMENU=y
# CONFIG_CMD_ELF is not set
# CONFIG_CMD_XIMG is not set
# CONFIG_CMD_EXPORTENV is not set
# CONFIG_CMD_IMPORTENV is not set
# CONFIG_CMD_FLASH is not set
# CONFIG_CMD_LOADS is not set
# CONFIG_CMD_ECHO is not set
# CONFIG_CMD_ITEST is not set
# CONFIG_CMD_SOURCE is not set
# CONFIG_CMD_SETEXPR is not set
CONFIG_CMD_TFTPSRV=y
# CONFIG_CMD_NFS is not set
CONFIG_CMD_MII=y
CONFIG_CMD_PING=y
# CONFIG_PARTITIONS is not set
CONFIG_OF_CONTROL=y
CONFIG_OF_EMBED=y
CONFIG_ENV_IS_IN_SPI_FLASH=y
CONFIG_NET_RANDOM_ETHADDR=y
# CONFIG_DM_WARN is not set
CONFIG_DM_DEVICE_REMOVE=y
CONFIG_DM_GPIO=y
CONFIG_MT7621_GPIO=y
CONFIG_MTD=y
CONFIG_MTDIDS_DEFAULT="nor0=mt7621"
CONFIG_MTDPARTS_DEFAULT="mtdparts=mt7621:384k(u-boot),64k(u-boot-env),256k(Factory),64k(EEPROM),64k(bs),1024k(cfg),15424k(kernel0),15424k(kernel1)"
CONFIG_DM_SPI_FLASH=y
CONFIG_SPI_FLASH=y
CONFIG_SPI_FLASH_BAR=y
CONFIG_SPI_FLASH_ATMEL=y
CONFIG_SPI_FLASH_EON=y
CONFIG_SPI_FLASH_GIGADEVICE=y
CONFIG_SPI_FLASH_MACRONIX=y
CONFIG_SPI_FLASH_SPANSION=y
CONFIG_SPI_FLASH_STMICRO=y
CONFIG_SPI_FLASH_SST=y
CONFIG_SPI_FLASH_WINBOND=y
CONFIG_SPI_FLASH_MTD=y
CONFIG_DM_ETH=y
CONFIG_MT7621_ETH=y
CONFIG_DEBUG_UART_BASE=0xbe000c00
CONFIG_DEBUG_UART_CLOCK=50000000
CONFIG_DM_SERIAL=y
CONFIG_SYS_NS16550=y
CONFIG_DM_SPI=y
CONFIG_RT6855A_SPI=y
# CONFIG_REGEX is not set
CONFIG_LZMA=y
CONFIG_SPL_LZMA=y
CONFIG_UBNT_APP=y
CONFIG_UBNT_PART_UBOOT_KSIZE=384
CONFIG_UBNT_PART_UBOOT_ENV_KSIZE=64
CONFIG_UBNT_PART_FACTORY_KSIZE=256
CONFIG_UBNT_PART_EEPROM_KSIZE=64
CONFIG_UBNT_PART_BOOTSELECT_KSIZE=64
CONFIG_UBNT_PART_CFG_KSIZE=1024
CONFIG_UBNT_PART_KERNEL0_KSIZE=15424
CONFIG_UBNT_PART_KERNEL1_KSIZE=15424
CONFIG_UBNT_PERSISTENT_LOG=y
# CONFIG_UBNT_SUPPORT_CSR_EFR32_BLE is not set
CONFIG_UBNT_SUPPORT_MTK_BLE=y
CONFIG_SYS_MEM_TOP_HIDE=32768
CONFIG_CMD_DM=y
CONFIG_CMD_I2C=y
CONFIG_I2C_SET_DEFAULT_BUS_NUM=y
CONFIG_DM_I2C=y
CONFIG_DM_I2C_COMPAT=y
CONFIG_SYS_I2C_MT7621=y
CONFIG_CMD_USB=y
CONFIG_HAVE_BLOCK_DEVICE=y
CONFIG_USB=y
CONFIG_DM_USB=y

#
# USB Host Controller Drivers
#
CONFIG_USB_HOST=y
CONFIG_USB_XHCI_HCD=y
# CONFIG_USB_XHCI_DWC3 is not set
# CONFIG_USB_XHCI_DWC3_OF_SIMPLE is not set
# CONFIG_USB_XHCI_PCI is not set
# CONFIG_USB_XHCI_FSL is not set
CONFIG_USB_XHCI_MT7621=y
# CONFIG_USB_EHCI_HCD is not set
# CONFIG_USB_OHCI_HCD is not set
# CONFIG_USB_UHCI_HCD is not set
# CONFIG_USB_DWC2 is not set
# CONFIG_USB_DWC3 is not set

#
# Legacy MUSB Support
#
# CONFIG_USB_MUSB_HCD is not set
# CONFIG_USB_MUSB_UDC is not set
# CONFIG_USB_DAVINCI is not set

#
# MUSB Controller Driver
#
# CONFIG_USB_MUSB_HOST is not set
# CONFIG_USB_MUSB_GADGET is not set
# CONFIG_USB_MUSB_TI is not set
# CONFIG_USB_MUSB_AM35X is not set
# CONFIG_USB_MUSB_DSPS is not set
# CONFIG_USB_MUSB_PIO_ONLY is not set

#
# USB Phy
#
# CONFIG_TWL4030_USB is not set
# CONFIG_OMAP_USB_PHY is not set
# CONFIG_ROCKCHIP_USB2_PHY is not set

#
# ULPI drivers
#

#
# USB peripherals
#
# CONFIG_USB_STORAGE is not set
# CONFIG_USB_KEYBOARD is not set
# CONFIG_USB_GADGET is not set
# CONFIG_USB_HOST_ETHER is not set
CONFIG_AUTOBOOT_KEYED=y
CONFIG_AUTOBOOT_PROMPT="Autobooting in %d seconds, press \"<Esc><Esc>\" to stop\n"
CONFIG_AUTOBOOT_STOP_STR="\x1b\x1b"
```

## gpl-uboot-u6lite-1.1.44/uboot-uap-mtk-1.1.44/configs/ubnt_uap_defconfig
```kconfig
CONFIG_MIPS=y
CONFIG_SPL_LDSCRIPT="arch/$(ARCH)/mach-mt7621/u-boot-spl-rom.lds"
CONFIG_SYS_TEXT_BASE=0x84000000
CONFIG_SPL_LIBCOMMON_SUPPORT=y
CONFIG_SPL_LIBGENERIC_SUPPORT=y
CONFIG_SPL_SERIAL_SUPPORT=y
CONFIG_MACH_MT7621=y
CONFIG_BOARD_MT7621_UBNT=y
CONFIG_BOARD_UBNT_UAP=y
CONFIG_MT7621_DRAM_FREQ_1200=y
CONFIG_ROM_EXCEPTION_VECTORS=y
CONFIG_MIPS_BOOT_FDT=y
CONFIG_DEFAULT_DEVICE_TREE="ubnt_uap"
CONFIG_DEBUG_UART=y
CONFIG_SPL_SYS_MALLOC_F_LEN=0x10000
# CONFIG_EXPERT is not set
CONFIG_FIT=y
CONFIG_FIT_SIGNATURE=y
CONFIG_FIT_VERBOSE=y
# CONFIG_ARCH_FIXUP_FDT_MEMORY is not set
CONFIG_DISPLAY_CPUINFO=y
# CONFIG_DISPLAY_BOARDINFO is not set
CONFIG_SPL=y
# CONFIG_SPL_RAW_IMAGE_SUPPORT is not set
CONFIG_SPL_SYS_MALLOC_SIMPLE=y
CONFIG_SPL_MTK_SUPPORT=y
CONFIG_SYS_PROMPT="MT7621 #"
CONFIG_CMD_BOOTMENU=y
# CONFIG_CMD_ELF is not set
# CONFIG_CMD_XIMG is not set
# CONFIG_CMD_EXPORTENV is not set
# CONFIG_CMD_IMPORTENV is not set
# CONFIG_CMD_FLASH is not set
CONFIG_CMD_GPIO=y
# CONFIG_CMD_LOADS is not set
# CONFIG_CMD_ECHO is not set
# CONFIG_CMD_ITEST is not set
# CONFIG_CMD_SOURCE is not set
# CONFIG_CMD_SETEXPR is not set
CONFIG_CMD_TFTPSRV=y
# CONFIG_CMD_NFS is not set
CONFIG_CMD_MII=y
# CONFIG_PARTITIONS is not set
CONFIG_OF_CONTROL=y
CONFIG_OF_EMBED=y
CONFIG_ENV_IS_IN_SPI_FLASH=y
CONFIG_NET_RANDOM_ETHADDR=y
# CONFIG_DM_WARN is not set
# CONFIG_DM_DEVICE_REMOVE is not set
CONFIG_DM_GPIO=y
CONFIG_MT7621_GPIO=y
CONFIG_MTD=y
CONFIG_DM_SPI_FLASH=y
CONFIG_SPI_FLASH=y
CONFIG_SPI_FLASH_BAR=y
CONFIG_SPI_FLASH_ATMEL=y
CONFIG_SPI_FLASH_EON=y
CONFIG_SPI_FLASH_GIGADEVICE=y
CONFIG_SPI_FLASH_MACRONIX=y
CONFIG_SPI_FLASH_SPANSION=y
CONFIG_SPI_FLASH_STMICRO=y
CONFIG_SPI_FLASH_SST=y
CONFIG_SPI_FLASH_WINBOND=y
CONFIG_SPI_FLASH_MTD=y
CONFIG_DM_ETH=y
CONFIG_MT7621_ETH=y
CONFIG_DEBUG_UART_BASE=0xbe000c00
CONFIG_DEBUG_UART_CLOCK=50000000
CONFIG_SYS_NS16550=y
CONFIG_DM_SPI=y
CONFIG_RT6855A_SPI=y
# CONFIG_REGEX is not set
CONFIG_LZMA=y
CONFIG_SPL_LZMA=y
CONFIG_UBNT_PART_UBOOT_KSIZE=384
CONFIG_UBNT_PART_UBOOT_ENV_KSIZE=64
CONFIG_UBNT_PART_FACTORY_KSIZE=64
CONFIG_UBNT_PART_EEPROM_KSIZE=64
CONFIG_UBNT_PART_BOOTSELECT_KSIZE=64
CONFIG_UBNT_PART_CFG_KSIZE=1024
CONFIG_UBNT_PART_KERNEL0_KSIZE=15552
CONFIG_UBNT_PART_KERNEL1_KSIZE=15552
```

## gpl-uboot-u6lite-1.1.44/uboot-uap-mtk-1.1.44/configs/ubnt_uf_olt_defconfig
```kconfig
CONFIG_MIPS=y
CONFIG_SPL_LDSCRIPT="arch/$(ARCH)/mach-mt7621/u-boot-spl-rom.lds"
CONFIG_SPL_LIBCOMMON_SUPPORT=y
CONFIG_SPL_LIBGENERIC_SUPPORT=y
CONFIG_SPL_SERIAL_SUPPORT=y
CONFIG_MACH_MT7621=y
CONFIG_BOARD_MT7621_UBNT=y
CONFIG_BOARD_UBNT_UF_OLT=y
CONFIG_MT7621_NAND_BOOT=y
CONFIG_MT7621_SPL_FLASH_SECTOR_SIZE=0x20000
CONFIG_MT7621_DRAM_FREQ_1066=y
CONFIG_ROM_EXCEPTION_VECTORS=y
CONFIG_DEFAULT_DEVICE_TREE="ubnt_uf_olt"
CONFIG_DEBUG_UART=y
CONFIG_SPL_SYS_MALLOC_F_LEN=0x10000
# CONFIG_EXPERT is not set
# CONFIG_ARCH_FIXUP_FDT_MEMORY is not set
CONFIG_BOOTDELAY=0
CONFIG_DISPLAY_CPUINFO=y
# CONFIG_DISPLAY_BOARDINFO is not set
# CONFIG_SPL_RAW_IMAGE_SUPPORT is not set
CONFIG_SPL_SYS_MALLOC_SIMPLE=y
CONFIG_SPL_MTK_SUPPORT=y
CONFIG_CMD_BOOTMENU=y
# CONFIG_CMD_ELF is not set
# CONFIG_CMD_IMI is not set
# CONFIG_CMD_XIMG is not set
# CONFIG_CMD_EXPORTENV is not set
# CONFIG_CMD_IMPORTENV is not set
# CONFIG_CMD_FLASH is not set
CONFIG_CMD_GPIO=y
CONFIG_CMD_I2C=y
# CONFIG_CMD_LOADS is not set
# CONFIG_CMD_ECHO is not set
# CONFIG_CMD_ITEST is not set
# CONFIG_CMD_SOURCE is not set
# CONFIG_CMD_SETEXPR is not set
# CONFIG_CMD_NFS is not set
CONFIG_CMD_MII=y
CONFIG_CMD_MTKUPGRADE=y
# CONFIG_PARTITIONS is not set
CONFIG_OF_CONTROL=y
CONFIG_OF_EMBED=y
CONFIG_ENV_IS_IN_NAND=y
CONFIG_NET_RANDOM_ETHADDR=y
# CONFIG_DM_WARN is not set
# CONFIG_DM_DEVICE_REMOVE is not set
CONFIG_DM_GPIO=y
CONFIG_MT7621_GPIO=y
CONFIG_DM_74X164=y
CONFIG_DM_PCA953X=y
CONFIG_DM_I2C=y
CONFIG_SYS_I2C_MT7621=y
CONFIG_LED=y
CONFIG_LED_GPIO=y
CONFIG_MTD=y
CONFIG_NAND=y
CONFIG_NAND_MT7621=y
CONFIG_NAND_MT7621_BBT_LAYER=y
CONFIG_SPL_NAND_MT7621=y
CONFIG_DM_SPI_FLASH=y
CONFIG_SPI_FLASH=y
CONFIG_SPI_FLASH_MACRONIX=y
CONFIG_DM_ETH=y
CONFIG_MT7621_ETH=y
CONFIG_BAUDRATE=57600
CONFIG_DEBUG_UART_BASE=0xbe000c00
CONFIG_DEBUG_UART_CLOCK=50000000
CONFIG_SYS_NS16550=y
CONFIG_DM_SPI=y
CONFIG_RT6855A_SPI=y
# CONFIG_RT6855A_SPI_FLASH_OPTIMIZATION is not set
# CONFIG_REGEX is not set
CONFIG_LZMA=y
CONFIG_SPL_LZMA=y
```

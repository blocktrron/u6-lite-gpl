## gpl-uboot-u6lite-1.1.44/uboot-uap-mtk-1.1.44/arch/mips/mach-mt7621/Kconfig
```kconfig
menu "MediaTek Ralink MT7621 platform"
	depends on MACH_MT7621

config SYS_SOC
	default "mt7621"

config SYS_CONFIG_NAME
	default "mt7621"

config SYS_DCACHE_SIZE
	default 32768

config SYS_DCACHE_LINE_SIZE
	default 32

config SYS_ICACHE_SIZE
	default 32768

config SYS_ICACHE_LINE_SIZE
	default 32

config SOC_MT7621
	bool
	select TARGET_MT7621
	help
	  Support MediaTek Ralink MT7621 SoC.

config SYS_TEXT_BASE
	default 0xbfc00000 if MT7621_SPI_BOOT && !(SPL || SKIP_LOWLEVEL_INIT)
	default 0x80200000 if SPL || SKIP_LOWLEVEL_INIT

config SYS_UBOOT_IMG_COMPRESS
	bool
	default y

config SPL_FRAMEWORK
	bool
	default y

config SPL_START_S_PATH
	string
	default "arch/mips/mach-mt7621"

config SPL_TEXT_BASE
	hex
	default 0xbfc00000 if MT7621_SPI_BOOT
	default 0x80100000 if MT7621_NAND_BOOT

config SPL_MTK_IMAGE_PAD
	bool
	default y

config SPL_MTK_IMAGE_COMBINE
	bool
	default y

config MIPS_SPL_STANDALONE_RELOC
	bool
	default y

config MT7621_ROM_BOOT
	bool
	default y if !SKIP_LOWLEVEL_INIT
	select ROM_EXCEPTION_VECTORS
	select MIPS_INIT_STACK_IN_SRAM
	select MIPS_STACK_SRAM_INIT

config MT7621_SPL_BOOT
	bool
	default y if SPL
	select SKIP_LOWLEVEL_INIT

choice
	prompt "Board select"

config BOARD_MT7621_EVB
	bool "MT7621 EVB"
	select SOC_MT7621

config BOARD_MT7621_UBNT
	bool "Ubiquiti MT7621"
	select SOC_MT7621

endchoice


source "board/ralink/mt7621_evb/Kconfig"
source "board/ubnt/Kconfig"

config MT7621_SINGLE_CORE_SUPPORT
	bool "Enable Single Core for MT7621"
	default n

choice
	prompt "Boot media select"
	default MT7621_SPI_BOOT

config MT7621_SPI_BOOT
	bool "Boot from SPI NOR flash"
	select CMD_SF
	select CMD_MTDPARTS

config MT7621_NAND_BOOT
	bool "Boot from Parallel NAND flash"
	select SPL
	select CRC_POSIX1003_2
	select CMD_NAND
	select CMD_MTDPARTS

endchoice

config MT7621_SPL_FLASH_SECTOR_SIZE
	hex "Flash sector size used for offset alignment"
	default 0x1000
	help
	  When SPL is searching for the second stage U-Boot image, all possible
	  offsets will be aligned with this value.

	  0x1000 for SPI NOR flashes with 4KB erase block size support
	  0x10000 for almost all SPI NOR flashes
	  0x20000 for NAND flashes with 128KB block size

config SKIP_LOWLEVEL_INIT
	bool "Skip CPU/DRAM initialization"
	default n
	default y if SPL
	depends on MACH_MT7621
	help
	  This option is used only when U-Boot is loaded from a debugger, or
	  used as a secondary stage bootloader (e.g. boot from NAND).

source "arch/mips/mach-mt7621/dramc/Kconfig"

endmenu
```

## gpl-uboot-u6lite-1.1.44/uboot-uap-mtk-1.1.44/arch/mips/mach-mt7621/dramc/Kconfig
```kconfig
menu "CPU & DDR configuration"

config MT7621_CPU_FREQ
	int "CPU Frequency (MHz)"
	range 400 1200
	default 880

choice
	prompt "DRAM Frequency"
	default MT7621_DRAM_FREQ_1200

config MT7621_DRAM_FREQ_400
	bool "400MHz"

config MT7621_DRAM_FREQ_800
	bool "800MHz"

config MT7621_DRAM_FREQ_1066
	bool "1066MHz"

config MT7621_DRAM_FREQ_1200
	bool "1200MHz"

endchoice

config MT7621_DRAM_FREQ
	int
	default "400" if MT7621_DRAM_FREQ_400
	default "800" if MT7621_DRAM_FREQ_800
	default "1066" if MT7621_DRAM_FREQ_1066
	default "1200" if MT7621_DRAM_FREQ_1200
	default "1200"

config MT7621_DRAM_INIT_USER_PARAM_FIRST
	bool "Use user-prefered DRAM initialization parameters first"
	default n

choice
	prompt "Source of DRAM init parameters"
	default MT7621_DRAM_INIT_USER_PARAM_PREDEFINED
	depends on MT7621_DRAM_INIT_USER_PARAM_FIRST

config MT7621_DRAM_INIT_USER_PARAM_PREDEFINED
	bool "Pre-defined"

config MT7621_DRAM_INIT_USER_PARAM_BOARD_PROVIDED
	bool "Board-provided"

endchoice

choice
	prompt "Prefered DDR2 init parameters"
	default MT7621_DRAM_DDR2_1024M
	depends on MT7621_DRAM_INIT_USER_PARAM_PREDEFINED

config MT7621_DRAM_DDR2_512M
	bool "64MB"

config MT7621_DRAM_DDR2_1024M
	bool "128MB"

config MT7621_DRAM_DDR2_512M_W9751G6KB_A02_1066MHZ
	bool "W9751G6KB_A02 @ 1066MHz (64MB)"

config MT7621_DRAM_DDR2_1024M_W971GG6KB25_800MHZ
	bool "W971GG6KB25 @ 800MHz (128MB)"

config MT7621_DRAM_DDR2_1024M_W971GG6KB18_1066MHZ
	bool "W971GG6KB18 @ 1066MHz (128MB)"

endchoice

choice
	prompt "Prefered DDR3 init parameters"
	default MT7621_DRAM_DDR3_2048M
	depends on MT7621_DRAM_INIT_USER_PARAM_PREDEFINED

config MT7621_DRAM_DDR3_1024M
	bool "128MB"

config MT7621_DRAM_DDR3_1024M_KGD
	bool "128MB KGD"

config MT7621_DRAM_DDR3_2048M
	bool "256MB"

config MT7621_DRAM_DDR3_4096M
	bool "512MB"

endchoice

if MACH_MT7621
config MT7621_DRAMC_DEBUG
	bool "Enable verbose output during DRAMC initialization"

config MT7621_DRAM_RESET_DELAY
	int "DRAM chipset reset delay requirement. unit: mircosecond"
	default 100

config UBNT_MT7621_DRAM_INIT_RECOVERY_SW_RESET
	bool "DRAM init failure recovery by software reset CPU"
	help
	  Enable software reset CPU through the chipset's reset control register
	  to recover the DRAM initialization failure

config UBNT_MT7621_DRAM_INIT_RECOVERY_HW_RESET
	bool "DRAM init failure recovery by hardware reset CPU"
	help
	  Enable hardware reset CPU by toggling GPIO to recover the DRAM
	  initialization failure. Hardware reset needs the hardware circuit
	  that connects GPIO to reset IC MR(Manual Reset) pin.

config UBNT_MT7621_DRAM_INIT_RECOVERY_HW_RESET_GPIO
	int "GPIO pin to trigger hard reset"
	default 6
	depends on UBNT_MT7621_DRAM_INIT_RECOVERY_HW_RESET

endif # MACH_MT7621

endmenu
```

## gpl-uboot-u6lite-1.1.44/uboot-uap-mtk-1.1.44/board/ralink/mt7621_evb/Kconfig
```kconfig
if BOARD_MT7621_EVB

config SYS_VENDOR
	default "ralink"

config SYS_BOARD
	default "mt7621_evb"

choice
	prompt "Default MTD layout"
	default MT7621_SPI_MTD_LAYOUT_DEFAULT if MT7621_SPI_BOOT
	default MT7621_NAND_MTD_LAYOUT_DEFAULT if MT7621_NAND_BOOT
	help
	  This MTD layout will be used for firmware/bootloader upgrade and
	  firmware bootup.

	  If Customized is selected, default mtdids and mtdparts must
	  be set (CONFIG_MTDIDS_DEFAULT and CONFIG_MTDPARTS_DEFAULT).

config MT7621_MTD_LAYOUT_CUSTOMIZE
	bool "Customize"

config MT7621_SPI_MTD_LAYOUT_DEFAULT
	bool "SPI default"
	depends on MT7621_SPI_BOOT

config MT7621_NAND_MTD_LAYOUT_DEFAULT
	bool "NAND default"
	depends on MT7621_NAND_BOOT

endchoice

config MT7621_FIRMWARE_OFFSET_DEFAULT
	hex "Default firmware offset"
	depends on MT7621_MTD_LAYOUT_CUSTOMIZE
	default 0xbfc50000 if MT7621_SPI_BOOT
	default 0x140000 if MT7621_NAND_BOOT
	help
	  Default firmware offset in flash. Used to bootup firmware.

endif
```

## gpl-uboot-u6lite-1.1.44/uboot-uap-mtk-1.1.44/board/ubnt/Kconfig
```kconfig
if BOARD_MT7621_UBNT
choice
prompt "UBNT product select"
config BOARD_UBNT_UAP
bool "Ubiquiti Unifi AP"
config BOARD_UBNT_USW
bool "Ubiquiti Unifi Switch"
config BOARD_UBNT_UF_OLT
bool "Ubiquiti UFiber OLT"
endchoice

source "board/ubnt/uap/Kconfig"
source "board/ubnt/usw/Kconfig"
source "board/ubnt/uf_olt/Kconfig"

config UBNT_APP
	bool "Enable ubntapp support"
	default n
choice
	prompt "Default MTD layout"
	default UBNT_MT7621_SPI_MTD_LAYOUT_DEFAULT if MT7621_SPI_BOOT
	default UBNT_MT7621_NAND_MTD_LAYOUT_DEFAULT if MT7621_NAND_BOOT
	help
	 This MTD layout will be used for firmware/bootloader upgrade and
	 firmware bootup.

	 If Customized is selected, default mtdids and mtdparts must
	 be set (CONFIG_MTDIDS_DEFAULT and CONFIG_MTDPARTS_DEFAULT).

config UBNT_MT7621_MTD_LAYOUT_CUSTOMIZE
	bool "Customize"

config UBNT_MT7621_SPI_MTD_LAYOUT_DEFAULT
	bool "SPI default"
	depends on MT7621_SPI_BOOT

config UBNT_MT7621_NAND_MTD_LAYOUT_DEFAULT
	bool "NAND default"
	depends on MT7621_NAND_BOOT

endchoice

config UBNT_MT7621_FIRMWARE_OFFSET_DEFAULT
	hex "Default firmware offset"
	depends on UBNT_MT7621_MTD_LAYOUT_CUSTOMIZE
	default 0xbfc50000 if MT7621_SPI_BOOT
	default 0x140000 if MT7621_NAND_BOOT
	help
	 Default firmware offset in flash. Used to bootup firmware.

menu "UBNT application specific setting"
	depends on UBNT_APP
config UBNT_PART_UBOOT_KSIZE
	int "UBoot Paritition Size"
	default "384"
config UBNT_PART_UBOOT_ENV_KSIZE
	int "UBoot Environment Variable Parition Size"
	default "64"
config UBNT_PART_FACTORY_KSIZE
	int "Factory Partition Size"
	default "64"
config UBNT_PART_EEPROM_KSIZE
	int "EEPROM Partition Size"
	default "64"
config UBNT_PART_BOOTSELECT_KSIZE
	int "Boot-select Pariation Size"
	default "64"
config UBNT_PART_CFG_KSIZE
	int "CFG Pariation Size"
	default "1024"
config UBNT_PART_KERNEL0_KSIZE
	int "Kernel0 Partition Size"
	default "15552"
config UBNT_PART_KERNEL1_KSIZE
	int "Kernel1 Partition Size"
	default "15552"
config UBNT_PERSISTENT_LOG
	bool "Support Kernel Oops Dump"
	default n
config SYS_MEM_TOP_HIDE
	int "Reserved memory for Kernel Oops Dump (Kbytes)"
	depends on UBNT_PERSISTENT_LOG
	default "32768"
config UBNT_SUPPORT_CSR_EFR32_BLE
	bool "Support CSR EFR32 ble"
	depends on BOARD_UBNT_UAP
	default n
config UBNT_SUPPORT_MTK_BLE
        bool "Support Mediatek ble"
	depends on BOARD_UBNT_UAP
	default n
endmenu
endif
```

## gpl-uboot-u6lite-1.1.44/uboot-uap-mtk-1.1.44/board/ubnt/uap/Kconfig
```kconfig
if BOARD_UBNT_UAP

config SYS_VENDOR
	default "ubnt"

config SYS_BOARD
	default "uap"

endif
```

## gpl-uboot-u6lite-1.1.44/uboot-uap-mtk-1.1.44/board/ubnt/uf_olt/Kconfig
```kconfig
if BOARD_UBNT_UF_OLT

config SYS_VENDOR
	default "ubnt"

config SYS_BOARD
	default "uf_olt"

endif
```

## gpl-uboot-u6lite-1.1.44/uboot-uap-mtk-1.1.44/board/ubnt/usw/Kconfig
```kconfig
if BOARD_UBNT_USW

config SYS_VENDOR
	default "ubnt"

config SYS_BOARD
	default "usw"

endif
```

## gpl-uboot-u6lite-1.1.44/uboot-uap-mtk-1.1.44/configs/mt7621_evb_defconfig
```kconfig
CONFIG_MIPS=y
CONFIG_MACH_MT7621=y
CONFIG_BOARD_MT7621_EVB=y
CONFIG_MT7621_DRAM_FREQ_1200=y
CONFIG_MT7621_SPI_BOOT=y
CONFIG_MT7621_SPL_FLASH_SECTOR_SIZE=0x1000
CONFIG_DEFAULT_DEVICE_TREE="mt7621_evb"
# CONFIG_ARCH_FIXUP_FDT_MEMORY is not set
CONFIG_ROM_EXCEPTION_VECTORS=y
# CONFIG_EXPERT is not set
CONFIG_DEBUG_UART=y
CONFIG_BOOTDELAY=0
CONFIG_DISPLAY_CPUINFO=y
# CONFIG_DISPLAY_BOARDINFO is not set
CONFIG_SPL=y
CONFIG_SPL_SYS_MALLOC_F_LEN=0x10000
CONFIG_TPL_SYS_MALLOC_F_LEN=0x400
CONFIG_SPL_LEGACY_IMAGE_SUPPORT=y
CONFIG_SPL_SYS_MALLOC_SIMPLE=y
# CONFIG_SPL_RAW_IMAGE_SUPPORT is not set
CONFIG_SPL_MTK_SUPPORT=y
CONFIG_SPL_SERIAL_SUPPORT=y
CONFIG_SPL_LIBCOMMON_SUPPORT=y
CONFIG_SPL_LIBGENERIC_SUPPORT=y
CONFIG_SPL_LDSCRIPT="arch/$(ARCH)/mach-mt7621/u-boot-spl-rom.lds"
CONFIG_CMDLINE=y
CONFIG_AUTOBOOT=y
CONFIG_CMD_BDI=y
CONFIG_CMD_CONSOLE=y
CONFIG_CMD_BOOTD=y
CONFIG_CMD_BOOTM=y
CONFIG_CMD_BOOTMENU=y
# CONFIG_CMD_ELF is not set
CONFIG_CMD_FDT=y
CONFIG_CMD_GO=y
CONFIG_CMD_RUN=y
CONFIG_CMD_MII=y
# CONFIG_CMD_IMI is not set
CONFIG_CMD_MTDPARTS=y
CONFIG_CMD_MTKUPGRADE=y
# CONFIG_CMD_XIMG is not set
# CONFIG_CMD_EXPORTENV is not set
# CONFIG_CMD_IMPORTENV is not set
# CONFIG_CMD_DM is not set
# CONFIG_CMD_FLASH is not set
# CONFIG_CMD_FPGA is not set
# CONFIG_CMD_LOADS is not set
# CONFIG_CMD_ECHO is not set
# CONFIG_CMD_ITEST is not set
# CONFIG_CMD_SOURCE is not set
# CONFIG_CMD_SETEXPR is not set
# CONFIG_CMD_NFS is not set
# CONFIG_PARTITIONS is not set
CONFIG_OF_CONTROL=y
CONFIG_OF_EMBED=y
CONFIG_ENV_IS_IN_SPI_FLASH=y
# CONFIG_DM_WARN is not set
# CONFIG_DM_DEVICE_REMOVE is not set
CONFIG_NET=y
CONFIG_NET_RANDOM_ETHADDR=y
CONFIG_MTD=y
CONFIG_DM_SPI_FLASH=y
CONFIG_SPI_FLASH=y
CONFIG_SPI_FLASH_BAR=y
CONFIG_SPI_FLASH_ATMEL=y
CONFIG_SPI_FLASH_EON=y
CONFIG_SPI_FLASH_GIGADEVICE=y
CONFIG_SPI_FLASH_MACRONIX=y
CONFIG_SPI_FLASH_SPANSION=y
CONFIG_SPI_FLASH_STMICRO=y
CONFIG_SPI_FLASH_SST=y
CONFIG_SPI_FLASH_WINBOND=y
CONFIG_SPI_FLASH_USE_4K_SECTORS=y
CONFIG_SPI_FLASH_MTD=y
CONFIG_DM_ETH=y
CONFIG_MT7621_ETH=y
CONFIG_BAUDRATE=57600
CONFIG_DEBUG_UART_BASE=0xbe000c00
CONFIG_DEBUG_UART_CLOCK=50000000
CONFIG_SYS_NS16550=y
CONFIG_DM_SPI=y
CONFIG_RT6855A_SPI=y
CONFIG_RT6855A_SPI_FLASH_OPTIMIZATION=y
# CONFIG_REGEX is not set
CONFIG_LZMA=y
CONFIG_SPL_LZMA=y
```
